#include "modbus_rtu.h"
#include "modbus_config.h"


// ============================================================
// CONSTRUCTOR
// ============================================================

ModbusRTU::ModbusRTU(Stream& serial,
                     int dePin,
                     int rePin)
  : _serial(serial)
{
  _dePin = dePin;
  _rePin = rePin;

  _t15 = 0;
  _t35 = 0;
  _bytePeriod = 0;
  _postDelay = 0;
  _readTimeout = 0;
}


// ============================================================
// BEGIN
// ============================================================

void ModbusRTU::begin(unsigned long baud,
                       uint32_t config)
{
  Serial.println(F("RTU: begin"));

  // ----------------------------------------------------------
  // Определяем количество бит на один UART-символ.
  //
  // 8N1 = 10 бит
  // 8E1 = 11 бит
  // 8N2 = 11 бит
  // 8E2 = 12 бит
  // ----------------------------------------------------------

  unsigned long bitsPerChar;

  switch (config) {

    case SERIAL_8E2:
    case SERIAL_8O2:

      bitsPerChar = 12;
      break;


    case SERIAL_8N2:
    case SERIAL_8E1:
    case SERIAL_8O1:

      bitsPerChar = 11;
      break;


    case SERIAL_8N1:
    default:

      bitsPerChar = 10;
      break;
  }


  // ----------------------------------------------------------
  // Расчёт времени одного символа.
  //
  // Единица измерения: микросекунды.
  //
  // Например для 9600 8N1:
  //
  // 10 / 9600 = 1.0417 ms
  // ----------------------------------------------------------

  _bytePeriod =
    (bitsPerChar * 1000000UL) / baud;


  // ----------------------------------------------------------
  // t1.5
  //
  // Максимальная допустимая пауза между байтами
  // одного RTU-кадра.
  //
  // Значение берётся из конфигурации проекта.
  //
  // Сейчас конфигурация рассчитана на текущий
  // режим CommTester.
  // ----------------------------------------------------------

  // ==========================================================
  // AUTOMATIC MODBUS RTU TIMING
  // ==========================================================
  //
  // Tchar = количество бит на символ / скорость
  //
  // t1.5 = 1.5 × Tchar
  // t3.5 = 3.5 × Tchar
  //
  // Все значения в микросекундах.
  //

  unsigned long tCharUs =
    (bitsPerChar * 1000000UL) / baud;

  _t15 = (tCharUs * 15UL) / 10UL;
  _t35 = (tCharUs * 35UL) / 10UL;


  // ----------------------------------------------------------
  // Задержка после последнего переданного байта.
  //
  // Нужна прежде всего для RS-485, чтобы последний символ
  // гарантированно завершил передачу до переключения
  // трансивера обратно в режим приёма.
  // ----------------------------------------------------------

  _postDelay = _bytePeriod;


  // ----------------------------------------------------------
  // RS-485 DE
  // ----------------------------------------------------------

  if (_dePin >= 0) {

    pinMode(_dePin, OUTPUT);
    digitalWrite(_dePin, LOW);
  }


  // ----------------------------------------------------------
  // RS-485 RE
  // ----------------------------------------------------------

  if (_rePin >= 0) {

    pinMode(_rePin, OUTPUT);
    digitalWrite(_rePin, LOW);
  }


  // ----------------------------------------------------------
  // Очистка возможного мусора во входном буфере.
  //
  // Перед началом работы нам нужен именно новый кадр.
  // ----------------------------------------------------------

  Serial.println(F("RTU: drain start"));
  unsigned long startMicros = micros();

  do {

    if (_serial.available() > 0) {

      startMicros = micros();
      _serial.read();
    }

  } while (micros() - startMicros < _t35);

  Serial.println(F("RTU: ready"));
}


// ============================================================
// SET TIMEOUT
// ============================================================

void ModbusRTU::setTimeout(unsigned long timeout)
{
  _readTimeout = timeout;
}


// ============================================================
// CALCULATE TIMING
// ============================================================

void ModbusRTU::calculateTiming()
{
  // Сейчас расчёт выполняется непосредственно в begin().
  //
  // Функция оставлена как отдельный элемент архитектуры,
  // чтобы впоследствии можно было централизовать расчёт
  // t1.5 / t3.5 для разных скоростей.
}


// ============================================================
// RS-485 TRANSMIT MODE
// ============================================================

void ModbusRTU::setTransmitMode()
{
  if (_dePin >= 0) {

    digitalWrite(_dePin, HIGH);
  }

  if (_rePin >= 0) {

    digitalWrite(_rePin, HIGH);
  }
}


// ============================================================
// RS-485 RECEIVE MODE
// ============================================================

void ModbusRTU::setReceiveMode()
{
  if (_dePin >= 0) {

    digitalWrite(_dePin, LOW);
  }

  if (_rePin >= 0) {

    digitalWrite(_rePin, LOW);
  }
}


// ============================================================
// READ ADU
// ============================================================

ModbusRTUError ModbusRTU::readAdu(ModbusADU& adu)
{
  // ----------------------------------------------------------
  // Сбрасываем длину предыдущего кадра.
  // ----------------------------------------------------------

  adu.setRtuLen(0);


  // ----------------------------------------------------------
  // Ожидаем первый байт.
  //
  // _readTimeout — максимальное время ожидания начала
  // входящего кадра.
  // ----------------------------------------------------------

  unsigned long startMillis = millis();

  while (!_serial.available()) {

    if (millis() - startMillis >= _readTimeout) {

      return MODBUS_RTU_TIMEOUT;
    }
  }


  // ----------------------------------------------------------
  // Принимаем кадр.
  // ----------------------------------------------------------

  uint16_t len = 0;

  unsigned long lastByteMicros = micros();


  while (len < 256) {

    if (_serial.available()) {

      lastByteMicros = micros();

      adu.rtu[len] = _serial.read();

      len++;

      continue;
    }


    // --------------------------------------------------------
    // Если между байтами появилась пауза больше t1.5,
    // считаем кадр завершённым.
    // --------------------------------------------------------

    if (micros() - lastByteMicros > _t15) {

      break;
    }
  }


  // ----------------------------------------------------------
  // Сохраняем фактическую длину кадра.
  // ----------------------------------------------------------

  adu.setRtuLen(len);


  // ----------------------------------------------------------
  // После последнего байта ожидаем t3.5.
  //
  // Это позволяет убедиться, что следующий кадр ещё
  // не начал поступать.
  // ----------------------------------------------------------

  while (micros() - lastByteMicros < _t35) {
  }


  // ----------------------------------------------------------
  // Если после t3.5 в буфере уже есть данные,
  // значит между кадрами не было необходимой паузы.
  // ----------------------------------------------------------

  if (_serial.available()) {
    // Preserve the bytes already received for diagnostics.
    return MODBUS_RTU_FRAME_ERROR;
  }


  // ----------------------------------------------------------
  // Короткий RTU-кадр не может содержать адрес, функцию и CRC.
  // Не вызываем crcGood() для длины меньше четырёх байт.
  // ----------------------------------------------------------

  if (len < 4) {
    return MODBUS_RTU_FRAME_ERROR;
  }


  // ----------------------------------------------------------
  // Проверяем CRC.
  // ----------------------------------------------------------

  if (!adu.crcGood()) {
    // Preserve the received frame length for RX/error diagnostics.
    return MODBUS_RTU_CRC_ERROR;
  }


  return MODBUS_RTU_SUCCESS;
}


// ============================================================
// WRITE ADU
// ============================================================

bool ModbusRTU::writeAdu(ModbusADU& adu)
{
  // ----------------------------------------------------------
  // Перед передачей обновляем CRC.
  // ----------------------------------------------------------

  adu.updateCrc();


  uint16_t len = adu.getRtuLen();


  // ----------------------------------------------------------
  // Переключаем интерфейс в режим передачи.
  // Для RS-232 эта функция ничего не делает.
  // ----------------------------------------------------------

  setTransmitMode();


  // ----------------------------------------------------------
  // Передаём весь кадр.
  // ----------------------------------------------------------

  for (uint16_t i = 0; i < len; i++) {

    _serial.write(adu.rtu[i]);
  }


  // ----------------------------------------------------------
  // Ждём завершения передачи UART.
  // ----------------------------------------------------------

  _serial.flush();


  // ----------------------------------------------------------
  // Даём последнему символу полностью завершиться.
  // ----------------------------------------------------------

  unsigned long startMicros = micros();

  while (micros() - startMicros < _postDelay) {
  }


  // ----------------------------------------------------------
  // Возвращаем интерфейс в режим приёма.
  // ----------------------------------------------------------

  setReceiveMode();


  return true;
}